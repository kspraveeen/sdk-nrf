## samples/wifi/radio_test/single_domain/boards/nrf7120dk_nrf7120_cpuapp.conf
```kconfig
#
# Copyright (c) 2026 Nordic Semiconductor
#
# SPDX-License-Identifier: LicenseRef-Nordic-5-Clause
#

CONFIG_WIFI_NRF71=y
CONFIG_NRF71_RADIO_TEST=y
CONFIG_SOC_NRF71_WIFI_BOOT=y

# Enable the necessary drivers
CONFIG_NRFX_TIMER=y
CONFIG_NRFX_GPPI=y

CONFIG_WIFI_NRF70=n
CONFIG_NRF70_RADIO_TEST=n
```
