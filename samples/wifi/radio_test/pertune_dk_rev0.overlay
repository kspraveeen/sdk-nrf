/
{
	perf_tune_label: perf-tune-node {
		status = "okay";
		compatible = "nordic,nrf700x-perftune";
		max-pwr-2g-dsss = <0x20>;
		max-pwr-2g-mcs0 = <0x0>;
		max-pwr-2g-mcs7 = <0x18>;
		max-pwr-5g-low-mcs0 = <0x0>;
		max-pwr-5g-low-mcs7 = <0x0>;
		max-pwr-5g-mid-mcs0 = <0x0>;
		max-pwr-5g-mid-mcs7 = <0x0>;
		max-pwr-5g-high-mcs0 = <0x0>;
		max-pwr-5g-high-mcs7 = <0x0>;
	};

};
