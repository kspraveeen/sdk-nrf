## dts/bindings/wifi/nordic,nrf700x-perftune.yaml
```yaml
# A YAML binding matching the node

description: This is a representation of the nRF700x PCB max pwr

compatible: "nordic,nrf700x-perftune"

include: base.yaml

properties:
  max-pwr-2g-dsss:
    type: int
    required: true
    description: |
           8-bit values for max tx power in 2.4GHz band for DSSS/CCK rates
  max-pwr-2g-mcs0:
    type: int
    required: true
    description: |
           8-bit values for max tx power in 2.4GHz band for MCS0 rate
  max-pwr-2g-mcs7:
    type: int
    required: true
    description: |
           8-bit values for max tx power in 2.4GHz band for MCS7 rate
  max-pwr-5g-low-mcs0:
    type: int
    required: true
    description: |
           8-bit values for max tx power in 5GHz band MCS0 low sub-band
  max-pwr-5g-low-mcs7:
    type: int
    required: true
    description: |
           8-bit values for max tx power in 5GHz band MCS7 low sub-band
  max-pwr-5g-mid-mcs0:
    type: int
    required: true
    description: |
           8-bit values for max tx power in 5GHz band MCS0 mid sub-band
  max-pwr-5g-mid-mcs7:
    type: int
    required: true
    description: |
           8-bit values for max tx power in 5GHz band MCS7 mid sub-band
  max-pwr-5g-high-mcs0:
    type: int
    required: true
    description: |
           8-bit values for max tx power in 5GHz band MCS0 high sub-band
  max-pwr-5g-high-mcs7:
    type: int
    required: true
    description: |
           8-bit values for max tx power in 5GHz band MCS7 high sub-band
```
